## Documentation/devicetree/bindings/clock/allwinner,sun60i-a733-ccu.yaml
```yaml
# SPDX-License-Identifier: (GPL-2.0-only OR BSD-2-Clause)
%YAML 1.2
---
$id: http://devicetree.org/schemas/clock/allwinner,sun60i-a733-ccu.yaml#
$schema: http://devicetree.org/meta-schemas/core.yaml#

title: Allwinner A733 Clock Control Unit

maintainers:
  - Enzo Adriano <enzo.adriano.code@gmail.com>

properties:
  "#clock-cells":
    const: 1

  "#reset-cells":
    const: 1

  compatible:
    const: allwinner,sun60i-a733-ccu

  reg:
    maxItems: 1

  clocks:
    items:
      - description: High Frequency Oscillator, usually 24 MHz
      - description: Low Frequency Oscillator, usually 32 kHz
      - description: Internal Oscillator

  clock-names:
    items:
      - const: hosc
      - const: losc
      - const: iosc

required:
  - "#clock-cells"
  - "#reset-cells"
  - compatible
  - reg
  - clocks
  - clock-names

additionalProperties: false

examples:
  - |
    clock-controller@2002000 {
        compatible = "allwinner,sun60i-a733-ccu";
        reg = <0x02002000 0x2000>;
        clocks = <&osc24M>, <&osc32k>, <&iosc>;
        clock-names = "hosc", "losc", "iosc";
        #clock-cells = <1>;
        #reset-cells = <1>;
    };

...
```

## Documentation/devicetree/bindings/pinctrl/allwinner,sun60i-a733-pinctrl.yaml
```yaml
# SPDX-License-Identifier: (GPL-2.0-only OR BSD-2-Clause)
%YAML 1.2
---
$id: http://devicetree.org/schemas/pinctrl/allwinner,sun60i-a733-pinctrl.yaml#
$schema: http://devicetree.org/meta-schemas/core.yaml#

title: Allwinner A733 Pin Controller

maintainers:
  - Andre Przywara <andre.przywara@arm.com>

properties:
  "#gpio-cells":
    const: 3
    description:
      GPIO consumers must use three arguments, first the number of the
      bank, then the pin number inside that bank, and finally the GPIO
      flags.

  "#interrupt-cells":
    const: 3
    description:
      Interrupt consumers must use three arguments, first the number
      of the bank, then the pin number inside that bank, and finally
      the interrupt flags.

  compatible:
    const: allwinner,sun60i-a733-pinctrl

  reg:
    maxItems: 1

  interrupts:
    minItems: 11
    maxItems: 11
    description:
      One interrupt per structural interrupt bank, sorted by bank number
      in ascending order. Port A has no pins on the A733, but the IRQ
      register layout still reserves the first bank slot.

  clocks:
    items:
      - description: Bus clock
      - description: High frequency oscillator
      - description: Low frequency oscillator

  clock-names:
    items:
      - const: apb
      - const: hosc
      - const: losc

  gpio-controller: true
  interrupt-controller: true
  gpio-line-names: true

  input-debounce:
    description:
      Debouncing periods in microseconds, one period per interrupt bank.
    $ref: /schemas/types.yaml#/definitions/uint32-array
    minItems: 11
    maxItems: 11

patternProperties:
  "^(([a-z0-9]{3,}|[a-oq-z][a-z0-9]*?)?-)+?(p[a-k][0-9]*?-)??pins?$":
    type: object

    properties:
      pins: true
      function: true
      bias-disable: true
      bias-pull-up: true
      bias-pull-down: true

      drive-strength:
        $ref: /schemas/types.yaml#/definitions/uint32
        enum: [10, 20, 30, 40]

      allwinner,pinmux:
        $ref: /schemas/types.yaml#/definitions/uint32-array
        description:
          Pinmux selector value, for each pin. Almost every time this value
          is the same for all pins, so any array shorter than the number of
          pins will repeat the last value, to allow just specifying a single
          cell for all cells.

    required:
      - pins
      - allwinner,pinmux
      - function

    additionalProperties: false

  "^vcc-p[a-k]-supply$":
    description:
      Power supplies for pin banks.

required:
  - "#gpio-cells"
  - compatible
  - reg
  - clocks
  - clock-names
  - gpio-controller
  - "#interrupt-cells"
  - interrupts
  - interrupt-controller

allOf:
  - $ref: pinctrl.yaml#

additionalProperties: false

examples:
  - |
    pio: pinctrl@2000000 {
        compatible = "allwinner,sun60i-a733-pinctrl";
        reg = <0x2000000 0x600>;
        interrupts = <0 67 4>, <0 69 4>, <0 71 4>, <0 73 4>,
                     <0 75 4>, <0 77 4>, <0 79 4>, <0 81 4>,
                     <0 83 4>, <0 85 4>, <0 87 4>;
        clocks = <&ccu 20>, <&osc24M>, <&osc32k>;
        clock-names = "apb", "hosc", "losc";
        gpio-controller;
        #gpio-cells = <3>;
        interrupt-controller;
        #interrupt-cells = <3>;

        mmc0-pins {
            pins = "PF0", "PF1", "PF2", "PF3", "PF4", "PF5";
            allwinner,pinmux = <2>;
            function = "mmc0";
            drive-strength = <30>;
            bias-pull-up;
        };
    };
```
